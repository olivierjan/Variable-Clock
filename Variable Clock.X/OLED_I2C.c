#include "OLED_I2C.h"
#include "mcc_generated_files/i2c1.h"
#include <string.h>
#include <xc.h>
#include "mcc_generated_files/mcc.h"

// Constant Fonts
const  uint8_t LARGE_FONTS[] = {
  0x08, // 0x08 = 8 - font width in pixels
  0x10, // 0x10 = 16 - font height in pixels
  0x20,
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  0x00, 0x06, 0x01, 0x01, 0x02, 0x02, 0x04, 0x04, 0x00, 0x00, 0x00, 0x00, 0x00, 0x00, 0x00, 0x00, // ~ 94
  };

const uint8_t SMALL_FONTS[] =
{
0x06, 0x08, 0x20, 0x5f,               // x_size, y_size, offset, number of char
0x00, 0x00, 0x00, 0x00, 0x00, 0x00,   // sp
0x00, 0x00, 0x00, 0x2f, 0x00, 0x00,   // !
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0x00, 0x00, 0x06, 0x09, 0x09, 0x06    // ~ (Degrees)
};

const  uint8_t TINY_FONTS[] =
{
0x04, 0x06, 0x20, 0x5f,   // x-size, y-size, offset, total characters
0x00, 0x00, 0x00, 0x03, 0xa0, 0x00, 0xc0, 0x0c, 0x00, 0xf9, 0x4f, 0x80, 0x6b, 0xeb, 0x00, 0x98, 0x8c, 0x80, 0x52, 0xa5, 0x80, 0x03, 0x00, 0x00,  // Space, !"#$%&'
0x01, 0xc8, 0x80, 0x89, 0xc0, 0x00, 0x50, 0x85, 0x00, 0x21, 0xc2, 0x00, 0x08, 0x40, 0x00, 0x20, 0x82, 0x00, 0x00, 0x20, 0x00, 0x18, 0x8c, 0x00,  // ()*+,-./
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0x48, 0xc4, 0x80, 0x74, 0x57, 0x80, 0x59, 0xe6, 0x80, 0x23, 0xe8, 0x80, 0x03, 0x60, 0x00, 0x8b, 0xe2, 0x00, 0x61, 0x0c, 0x00                     // zyx{|}~
};

/*Private Variables*/
static Current_Font_s cfont;

const uint8_t SOjavaLogo[] = 
{
	0xFC, 0xFE, 0xFF, 0x0F, 0x03, 0x03, 0x03, 0x03, 0x03, 0x03, 0x03, 0x03, 0x03, 0x03, 0x03, 0x03, 
	0x03, 0x03, 0x03, 0x03, 0x83, 0x83, 0x83, 0x83, 0x83, 0x83, 0x83, 0x83, 0x03, 0x03, 0x03, 0x03, 
	0x03, 0x03, 0x03, 0x03, 0x03, 0x03, 0x03, 0x03, 0x03, 0x03, 0x03, 0x03, 0xFF, 0xFF, 0xFE, 0x00, 
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	0x08, 0x04, 0x07, 0x01, 0x00, 0x00, 0x00, 0x00, 0x00, 0x00, 0x00, 0x00, 0x00, 0x00, 0x00, 0x00 
};

/*Memory Buffer Display*/
static uint8_t buffer[SSD1306_LCDHEIGHT * SSD1306_LCDWIDTH / 8];


/*Private Functions Prototypes*/
void ssd1306_command( uint8_t command );
void ssd1306_data( uint8_t value );
int16_t width( void );
int16_t height( void );
void swap_num( int16_t *a, int16_t *b );


/* Function Definition*/
void OLED_Init( void )
{
  //I2C1_Initialize();
  //I2C1_Stop();
  __delay_ms(100);
  ssd1306_command( SSD1306_DISPLAY_OFF);
  ssd1306_command( SSD1306_SET_DISPLAY_CLOCK_DIV_RATIO);
  ssd1306_command( 0x80);
  ssd1306_command( SSD1306_SET_MULTIPLEX_RATIO );
  ssd1306_command( SSD1306_LCDHEIGHT - 1 );
  ssd1306_command( SSD1306_SET_DISPLAY_OFFSET );
  ssd1306_command(0x00);
  ssd1306_command( SSD1306_SET_START_LINE|0x00);  // Line: 0
  ssd1306_command( SSD1306_CHARGE_PUMP );
  // ssd1306_command(0x10); This will be used with External VCC
  ssd1306_command(0x14);
  ssd1306_command( SSD1306_MEMORY_ADDR_MODE );
  ssd1306_command(0x00);  //Horizontal Addressing Mode is Used
  ssd1306_command( SSD1306_SET_SEGMENT_REMAP| 0x01);
  ssd1306_command( SSD1306_COM_SCAN_DIR_DEC );
  
#if defined SSD1306_128_32
  ssd1306_command( SSD1306_SET_COM_PINS );
  ssd1306_command( 0x02 );
  ssd1306_command( SSD1306_SET_CONTRAST_CONTROL );
  ssd1306_command(0x8F);

#elif defined SSD1306_128_64
  ssd1306_command( SSD1306_SET_COM_PINS );
  ssd1306_command( 0x12 );
  ssd1306_command( SSD1306_SET_CONTRAST_CONTROL );
  // ssd1306_command(0x9F);  Use with External VCC
  ssd1306_command(0xCF);
#endif
  
  ssd1306_command( SSD1306_SET_PRECHARGE_PERIOD );
  // ssd1306_command( 0x22 ); Use with External VCC
  ssd1306_command( 0xF1 );
  ssd1306_command( SSD1306_SET_VCOM_DESELECT );
  ssd1306_command( 0x40 );
  ssd1306_command( SSD1306_DISPLAY_ALL_ON_RESUME );
  ssd1306_command( SSD1306_NORMAL_DISPLAY );
  ssd1306_command( SSD1306_DEACTIVATE_SCROLL );
  ssd1306_command( SSD1306_DISPLAY_ON );

  //OLED_SetFont( TINY_FONTS );
  OLED_SetFont( LARGE_FONTS );
  __delay_ms(100);
  OLED_Image(&SOjavaLogo[0]);
  OLED_Update();
}

int16_t OLED_Width( void )
{
  return width();
}

int16_t OLED_Height( void )
{
  return height();
}

void OLED_SetFont( const uint8_t *font)
{
  cfont.font = font;
  cfont.x_size = *(font+0);
  cfont.y_size = *(font+1);
  cfont.offset  = *(font+2);
  cfont.numchars  = *(font+3);
  cfont.inverted = FALSE;
}

void OLED_InvertFont( uint8_t invert_status )
{
  if( invert_status )
  {
    cfont.inverted = TRUE;
  }
  else
  {
    cfont.inverted = FALSE;
  }
}

void OLED_Update( void )
{
  int16_t i = 0;
  int16_t x = 0;
  ssd1306_command( SSD1306_SET_COLUMN_ADDR );
  ssd1306_command(0);   // Column start address (0 = reset)
  ssd1306_command( SSD1306_LCDWIDTH-1 ); // Column end address (127 = reset)

  ssd1306_command( SSD1306_SET_PAGE_ADDR );
  ssd1306_command(0); // Page start address (0 = reset)
  #if SSD1306_LCDHEIGHT == 64
    ssd1306_command(7); // Page end address
  #endif
  #if SSD1306_LCDHEIGHT == 32
    ssd1306_command(3); // Page end address
  #endif
  #if SSD1306_LCDHEIGHT == 16
    ssd1306_command(1); // Page end address
  #endif

  for (i=0; i<(SSD1306_LCDWIDTH*SSD1306_LCDHEIGHT/8); i++)
  {
    // Send data for Transmission
    
      i2c1_writeNBytesRegister(SSD1306_ADDR, 0x40, &buffer[i], 16); 
      i+=15;
  }
}

void OLED_SetContrast( uint8_t contrast )
{
  ssd1306_command( SSD1306_SET_CONTRAST_CONTROL );
  ssd1306_command(contrast);
}

void OLED_ClearDisplay( void )
{
  memset(buffer, 0, (SSD1306_LCDWIDTH*SSD1306_LCDHEIGHT/8));
}

void OLED_FillDisplay( void )
{
  memset(buffer, 0xFF, (SSD1306_LCDWIDTH*SSD1306_LCDHEIGHT/8));
}

void OLED_InvertDisplay( int16_t value )
{
  if( value )
  {
    ssd1306_command( SSD1306_INVERT_DISPLAY );
  }
  else
  {
    ssd1306_command( SSD1306_NORMAL_DISPLAY );
  }
}

void OLED_DrawPixel( int16_t x, int16_t y, uint8_t color)
{
  if ( (x >= width()) || (y >= height()))
    return;

  switch (color)
  {
    case WHITE:   buffer[x+ (y/8)*SSD1306_LCDWIDTH] |=  (1 << (y&7)); break;
    case BLACK:   buffer[x+ (y/8)*SSD1306_LCDWIDTH] &= ~(1 << (y&7)); break;
    case INVERSE: buffer[x+ (y/8)*SSD1306_LCDWIDTH] ^=  (1 << (y&7)); break;
  }
}

/**
 * @brief Draws a line on OLED.
 *
 * Draws a line on OLED by using the specified parameters.
 * <a href="https://en.wikipedia.org/wiki/Bresenham%27s_line_algorithm">
 * Algorithm Used</a>
 * <a href="http://www.edaboard.com/thread68526.html#post302856"> Program Used
 * </a>
 *
 * @param x_start: x coordinate of start point. Valid values: 0..127
 * @param y_start: x coordinate of start point. Valid values: 0..63
 * @param x_end: x coordinate of end point. Valid values: 0..127
 * @param y_end: y coordinate of end point. Valid values: 0..63
 * @param color: color parameter. Valid values: 0 and 1
 */
void OLED_Line( int16_t x_start, int16_t y_start, int16_t x_end, int16_t y_end, uint8_t color)
{
  int16_t x, y; 
  int16_t addx, addy, dx, dy;
  int32_t P;
  int16_t i;
  dx = abs((int16_t)(x_end - x_start));
  dy = abs((int16_t)(y_end - y_start));
  x = x_start;
  y = y_start;

  if(x_start > x_end)
    addx = -1;
  else
    addx = 1;

  if(y_start > y_end)
    addy = -1;
  else
    addy = 1;

  if(dx >= dy)
  {
    P = 2*dy - dx;

    for(i=0; i<=dx; ++i)
    {
      OLED_DrawPixel (x,y,color);
      if(P < 0)
      {
        P += 2*dy;
        x += addx;
      }
      else
      {
        P += 2*dy - 2*dx;
        x += addx;
        y += addy;
      }
    }
  }
  else
  {
    P = 2*dx - dy;
    for(i=0; i<=dy; ++i)
    {
      OLED_DrawPixel (x,y,color);

      if(P < 0)
      {
        P += 2*dx;
        y += addy;
      }
      else
      {
        P += 2*dx - 2*dy;
        x += addx;
        y += addy;
      }
    }
  }
}
/*
void OLED_DrawLine(int16_t x0, int16_t y0, int16_t x1, int16_t y1, int16_t color)
{
  int16_t dx, dy;
  int16_t err;
  int16_t ystep;
  int16_t steep = abs(y1 - y0) > abs(x1 - x0);
  if (steep)
  {
    swap_num(&x0, &y0);
    swap_num(&x1, &y1);
  }

  if (x0 > x1)
  {
    swap_num(&x0, &x1);
    swap_num(&y0, &y1);
  }

  dx = x1 - x0;
  dy = abs(y1 - y0);

  err = dx / 2;

  if (y0 < y1)
  {
    ystep = 1;
  }
  else
  {
    ystep = -1;
  }

  for (; x0<=x1; x0++)
  {
    if (steep)
    {
      OLED_DrawPixel(y0, x0, color);
    }
    else
    {
      OLED_DrawPixel(x0, y0, color);
    }
    err -= dy;
    if (err < 0)
    {
      y0 += ystep;
      err += dx;
    }
  }
}
*/

/**
 * @brief OLED Vertical Line.
 *
 * Draw vertical line between of length specified by y_start and y_end, and at
 * position specified by x_pos
 *
 * @param y_start: y position to start vertical line. Valid values: 0..63
 * @param y_end: y position to end vertical line. Valid values: 0..63
 * @param x_pos: x position. Valid values: 0..127
 * @param color: color parameter. Valid values: 0 and 1
 */
void OLED_V_Line ( int16_t y_start, int16_t y_end, int16_t x_pos, uint8_t color)
{
  int16_t temp;
  if( y_start > y_end )
  {
    temp = y_start;
    y_start = y_end;
    y_end = temp;
  }

  while( y_start <= y_end )
  {
    OLED_DrawPixel(x_pos, y_start, color);
    y_start++;
  }
}

/**
 * @brief OLED Horizontal Line.
 *
 * Draw horizontal line between of length specified by x_start and x_end, and at
 * position specified by y_pos
 *
 * @param x_start: y position to start horizontal line. Valid values: 0..127
 * @param x_end: y position to end horizontal line. Valid values: 0..127
 * @param y_pos: x position. Valid values: 0..63
 * @param color: color parameter. Valid values: 0 and 1
 */
void OLED_H_Line( int16_t x_start, int16_t x_end, int16_t y_pos, uint8_t color)
{
  int16_t temp;
  if( x_start > x_end )
  {
    temp = x_start;
    x_start = x_end;
    x_end = temp;
  }

  while( x_start <= x_end )
  {
    OLED_DrawPixel(x_start, y_pos, color);
    x_start++;
  }
}

/**
 * @brief Draws a rectangle on OLED.
 *
 * Draws a rectangle on OLED by using the specified parameters.
 *
 * @param x1: x coordinate of the upper left rectangle corner.
 * Valid values: 0..127
 * @param y1: y coordinate of the upper left rectangle corner.
 * Valid values: 0..63
 * @param x2: x coordinate of the lower right rectangle corner.
 * Valid values: 0..127
 * @param y2: y coordinate of the lower right rectangle corner.
 * Valid values: 0..63
 * @param color: color parameter. Valid values: 0 and 1
 */
void OLED_Rectangle( int16_t x1, int16_t y1, int16_t x2, int16_t y2, uint8_t color)
{
  /*
  x1,y1 Upper Left
  y1,y2 Bottom Right
  */
  OLED_H_Line(x1, x2, y1, color);
  OLED_H_Line(x1, x2, y2, color);
  OLED_V_Line(y1, y2, x1, color);
  OLED_V_Line(y1, y2, x2, color);
}

void OLED_FillRectangle( int16_t x1, int16_t y1, int16_t x2, int16_t y2, uint8_t color)
{
  int16_t i;
  for( i=x1; i<=x2; i++ )
  {
    OLED_V_Line(y1, y2, i, color );
  }
}

// Draw a triangle
void OLED_Triangle(int16_t x0, int16_t y0, int16_t x1, int16_t y1, int16_t x2, int16_t y2, uint8_t color)
{
  OLED_Line(x0, y0, x1, y1, color);
  OLED_Line(x1, y1, x2, y2, color);
  OLED_Line(x2, y2, x0, y0, color);
}

/**
 * @brief OLED Image.
 *
 * Displays bitmap image on OLED.
 *
 * @param *image: image to be displayed. Bitmap array must be located in code
 * memory. Use the mikroC PRO for PIC integrated Glcd Bitmap Editor to convert
 * image to a constant array suitable for displaying on Glcd.
 */
void OLED_Image( const uint8_t *image)
{
  uint16_t i;
  for( i=0; i<(SSD1306_LCDWIDTH*SSD1306_LCDHEIGHT/8); i++)
  {
    buffer[i] = *(image+i);
  }
}

/**
 * @brief Draws a Circle on OLED.
 *
 * Draws a Circle on OLED by using the specified parameters.
 * <a href="https://en.wikipedia.org/wiki/Midpoint_circle_algorithm">
 * Mid Point Circle Algorithm Weblink</a>
 *
 * @param x_center: x coordinate of the circle center. Valid values: 0..127
 * @param y_center: y coordinate of the circle center. Valid values: 0..63
 * @param radius: radius of the circle.
 * @param color: color parameter. Valid values: 0 and 1
 */
void OLED_Circle( int16_t x0, int16_t y0, int16_t r, uint8_t color )
{
  int16_t f = 1 - r;
  int16_t ddF_x = 1;
  int16_t ddF_y = -2 * r;
  int16_t x = 0;
  int16_t y = r;

  OLED_DrawPixel(x0  , y0+r, color);
  OLED_DrawPixel(x0  , y0-r, color);
  OLED_DrawPixel(x0+r, y0  , color);
  OLED_DrawPixel(x0-r, y0  , color);

  while (x<y)
  {
    if (f >= 0)
    {
      y--;
      ddF_y += 2;
      f += ddF_y;
    }
    x++;
    ddF_x += 2;
    f += ddF_x;

    OLED_DrawPixel(x0 + x, y0 + y, color);
    OLED_DrawPixel(x0 - x, y0 + y, color);
    OLED_DrawPixel(x0 + x, y0 - y, color);
    OLED_DrawPixel(x0 - x, y0 - y, color);
    OLED_DrawPixel(x0 + y, y0 + x, color);
    OLED_DrawPixel(x0 - y, y0 + x, color);
    OLED_DrawPixel(x0 + y, y0 - x, color);
    OLED_DrawPixel(x0 - y, y0 - x, color);
  }
}

/**
 * @brief Write character on OLED.
 *
 * Prints character on the OLED.
 *
 * @param value: Character to be written.
 * @param x: character starting position on x-axis. Valid values: 0..127
 * @param y: character starting position on x-axis. Valid values: 0..63
 */
void OLED_Write( int16_t x, int16_t y, char* value )
{
  int16_t font_idx = 0;
  int16_t rowcnt = 0;
  int16_t cnt = 0;
  int16_t b;
  int16_t temp = 0;

  int16_t cbyte, cx, cy;
  int16_t cbit;

  if( cfont.y_size%8 == 0)
  {
    font_idx = ((*value-cfont.offset)*(cfont.x_size*(cfont.y_size/8))) + 4;
    for ( rowcnt=0; rowcnt<(cfont.y_size/8); rowcnt++ )
    {
      for( cnt=0; cnt<cfont.x_size; cnt++ )
      {
        temp = *(cfont.font + font_idx + cnt + (rowcnt*cfont.x_size));
        for ( b=0; b<8; b++ )
        {
          if ( temp & (1<<b) )
          {
            if (cfont.inverted == FALSE )
              OLED_DrawPixel(x+cnt, y+(rowcnt*8)+b, TRUE);
            else
              OLED_DrawPixel(x+cnt, y+(rowcnt*8)+b, FALSE);
          }
          else
          {
            if (cfont.inverted == FALSE )
              OLED_DrawPixel(x+cnt, y+(rowcnt*8)+b, FALSE);
            else
              OLED_DrawPixel(x+cnt, y+(rowcnt*8)+b, TRUE);
          }
        }
      }
    }
  }
  else
  {
    font_idx = ((*value-cfont.offset)*((cfont.x_size*cfont.y_size)/8)) + 4;
    cbyte = *(cfont.font + font_idx);
    cbit = 7;
    for ( cx=0; cx<cfont.x_size; cx++ )
    {
      for ( cy=0; cy<cfont.y_size; cy++ )
      {
        if ( (cbyte & (1<<cbit)) != 0)
        {
          if ( cfont.inverted == FALSE )
            OLED_DrawPixel(x+cx, y+cy, TRUE);
          else
            OLED_DrawPixel(x+cx, y+cy, FALSE);
        }
        else
        {
          if ( cfont.inverted == FALSE )
            OLED_DrawPixel(x+cx, y+cy, FALSE);
          else
            OLED_DrawPixel(x+cx, y+cy, TRUE);
        }
        cbit--;
        if (cbit < 0)
        {
          cbit=7;
          font_idx++;
          cbyte= *(cfont.font+font_idx);
        }
      }
    }
  }
}

/**
 * @brief Write Text on OLED.
 *
 * Prints text on the OLED.
 *
 * @param *text: Pointer to the array of the text to be written.
 * @param x: character starting position on x-axis. Valid values: 0..127
 * @param y: character starting position on x-axis. Valid values: 0..63
 */
void OLED_Write_Text(int16_t x, int16_t y, char* text)
{
  int16_t cnt;
  size_t length;
  int16_t cursorpos=0;
  
  length = strlen(text);
  if (x == RIGHT)
    x = 128-((int16_t)length*cfont.x_size);
  if (x == CENTER)
    x = (128-((int16_t)length*cfont.x_size))/2;
  
  for ( cnt=0; cnt<length; cnt++ )
  
    if (*text == 0x0a){
        y+=cfont.y_size;
        text++;
        cursorpos=0;
    }  else {
        OLED_Write(x + (cursorpos*(cfont.x_size)), y, text++ );
        cursorpos++;
    }
}

void ssd1306_command( uint8_t command )
{
  //int16_t control = 0x00;  // Co=0, D/C=0
 
  i2c1_write1ByteRegister(SSD1306_ADDR, 0x00, command);
  //I2C1_Start();
  //I2C1_Wr(SSD1306_ADDR << 1);
  //I2C1_Wr(control);
  //I2C1_Wr(command);
  //I2C1_Stop();
}

void ssd1306_data( uint8_t value )
{
  
  i2c1_write1ByteRegister(SSD1306_ADDR, 0x40, value);  
  //int16_t control = 0x40;   // Co = 0, D/C = 1
  //I2C1_Start();
  //I2C1_Wr( SSD1306_ADDR << 1);
  //I2C1_Wr(control);
  //I2C1_Wr(value);
  //I2C1_Stop();
}

int16_t width( void )
{
  return SSD1306_LCDWIDTH;
}

int16_t height( void )
{
  return SSD1306_LCDHEIGHT;
}

void swap_num( int16_t *a, int16_t *b )
{
  int16_t temp = *a;
  *a = *b;
  *b = temp;
}